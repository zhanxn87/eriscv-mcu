## eriscv-m0/sw/rtos/zephyr/boards/riscv/eriscv_mcu/Kconfig.board
```kconfig
# eRISCV-M0 board configuration
# Copyright (c) 2024 eRISCV-MCU Contributors
# SPDX-License-Identifier: Apache-2.0

config BOARD_ERISCV_MCU
	bool "eRISCV-MCU Board"
	depends on SOC_ERISCV_MCU
	help
	  eRISCV-M0 is the baseline product variant of the eRISCV-MCU
	  educational RISC-V MCU.  Features RV32IC_Zicsr_Zifencei,
	  32 KB ITCM, 32 KB DTCM, UART, GPIO, APB Timer, SPI, WDT, and PLIC.
	  No M-extension or PMP.
```

## eriscv-m0/sw/rtos/zephyr/soc/riscv/eriscv_mcu/Kconfig.defconfig
```kconfig
# eRISCV-MCU M0 SoC default configuration
# Copyright (c) 2024 eRISCV-MCU Contributors
# SPDX-License-Identifier: Apache-2.0

if SOC_ERISCV_MCU

config SOC
	default "eriscv_mcu"

config NUM_IRQS
	int
	default 32

config SYS_CLOCK_HW_CYCLES_PER_SEC
	int
	default 100000000

config RISCV_ISA_EXT_M
	bool
	default n

config RISCV_ISA_EXT_C
	bool
	default y

endif # SOC_ERISCV_MCU
```

## eriscv-m1/sw/rtos/zephyr/boards/riscv/eriscv_mcu/Kconfig.board
```kconfig
# eRISCV-M1 board configuration
# Copyright (c) 2024 eRISCV-MCU Contributors
# SPDX-License-Identifier: Apache-2.0

config BOARD_ERISCV_MCU
	bool "eRISCV-M1 Board"
	depends on SOC_ERISCV_MCU
	help
	  eRISCV-M1 is the M-extension + PMP product variant of the
	  eRISCV-MCU educational RISC-V MCU.  Features RV32IMC_Zicsr_Zifencei,
	  64 KB ITCM, 64 KB DTCM, UART, GPIO, APB Timer, SPI, WDT, and PLIC.
```
